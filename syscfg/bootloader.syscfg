/**
 * @cliArgs --board "/ti/boards/LP_MSPM0G3507" --product "mspm0_sdk@2.10.00.04"
 * @versions {"tool":"1.27.1+4634"}
 */
scripting.excludeFromBuild("Event.dot");

/**
 * Import the modules used in this configuration.
 */
const GPIO    = scripting.addModule("/ti/driverlib/GPIO", {}, false);
const GPIO1   = GPIO.addInstance();
const GPIO2   = GPIO.addInstance();
const SYSCTL  = scripting.addModule("/ti/driverlib/SYSCTL");
const SYSTICK = scripting.addModule("/ti/driverlib/SYSTICK");
const TIMER   = scripting.addModule("/ti/driverlib/TIMER", {}, false);
const TIMER1  = TIMER.addInstance();
const UART    = scripting.addModule("/ti/driverlib/UART", {}, false);
const UART1   = UART.addInstance();

/**
 * Write custom configuration values to the imported modules.
 */
GPIO1.$name                         = "LED";
GPIO1.associatedPins[0].$name       = "PIN_0";
GPIO1.associatedPins[0].pin.$assign = "j19_expansion.5";

const Board = scripting.addModule("/ti/driverlib/Board", {}, false);

GPIO2.$name                         = "OLED";
GPIO2.associatedPins.create(2);
GPIO2.associatedPins[0].$name       = "OLED_SCL";
GPIO2.associatedPins[0].pin.$assign = "boosterpack.9";
GPIO2.associatedPins[1].$name       = "OLED_SDA";
GPIO2.associatedPins[1].pin.$assign = "boosterpack.10";

SYSCTL.clockTreeEn = true;

TIMER1.$name             = "TIMER_0";
TIMER1.timerMode         = "PERIODIC";
TIMER1.interrupts        = ["ZERO"];
TIMER1.timerClkDiv       = 8;
TIMER1.interruptPriority = "1";
TIMER1.timerPeriod       = "1 ms";
TIMER1.timerStartTimer   = true;

UART1.$name                    = "UART_0";
UART1.interruptPriority        = "1";
UART1.targetBaudRate           = 115200;
UART1.rxFifoThreshold          = "DL_UART_RX_FIFO_LEVEL_ONE_ENTRY";
UART1.enabledInterrupts        = ["RX","RX_TIMEOUT_ERROR"];
UART1.digitalGlitchFilter      = 10;
UART1.peripheral.$assign       = "UART0";
UART1.peripheral.rxPin.$assign = "boosterpack.33";
UART1.peripheral.txPin.$assign = "boosterpack.34";
UART1.txPinConfig.$name        = "ti_driverlib_gpio_GPIOPinGeneric0";
UART1.rxPinConfig.$name        = "ti_driverlib_gpio_GPIOPinGeneric1";

/**
 * Pinmux solution for unlocked pins/peripherals. This ensures that minor changes to the automatic solver in a future
 * version of the tool will not impact the pinmux you originally saw.  These lines can be completely deleted in order to
 * re-solve from scratch.
 */
Board.peripheral.$suggestSolution          = "DEBUGSS";
Board.peripheral.swclkPin.$suggestSolution = "j25_expansion.16";
Board.peripheral.swdioPin.$suggestSolution = "j25_expansion.14";
TIMER1.peripheral.$suggestSolution         = "TIMA0";
